## drivers/gpu/drm/mediatek/Kconfig
```kconfig
config DRM_MEDIATEK
	tristate "DRM Support for Mediatek SoCs"
	depends on DRM
	depends on ARCH_MEDIATEK || (ARM && COMPILE_TEST)
	select DRM_GEM_CMA_HELPER
	select DRM_KMS_HELPER
	select DRM_MIPI_DSI
	select DRM_PANEL
	select IOMMU_DMA
	select MEMORY
	select MTK_SMI
	select MTK_DISPLAY_CMDQ
	help
	  Choose this option if you have a Mediatek SoCs.
	  The module will be called mediatek-drm
	  This driver provides kernel mode setting and
	  buffer management to userspace.

config MTK_DISPLAY_CMDQ
    bool "CMDQ Support for Mediatek DRM driver"
    help
      Choose this option if you have a Mediatek SoCs.
      The module will be called mediatek-drm
      This driver provides kernel mode setting and
      buffer management to userspace.

config DRM_MEDIATEK_HDMI
	tristate "DRM HDMI Support for Mediatek SoCs"
	depends on DRM_MEDIATEK
        select SND_SOC_HDMI_CODEC if SND_SOC
        select GENERIC_PHY
        help
          DRM/KMS HDMI driver for Mediatek SoCs

config DRM_HDMI_MAIN_PATH
	tristate "DRM HDMI main path Support for Mediatek SoCs"
	depends on DRM_MEDIATEK_HDMI
        help
          DRM/KMS HDMI main path driver for Mediatek SoCs

config MTK_DRM_DISABLE_HW_OVL
	tristate "diable hw overlay Support for Mediatek SoCs"
        help
          diable hw overlay Support for Mediatek SoCs

config MTK_DRM_DISABLE_FBDEV
	tristate "diable fbdev Support for Mediatek SoCs"
        help
          diable fbdev Support for Mediatek SoCs
```

## drivers/misc/mediatek/nand/Kconfig
```kconfig
#nand
menuconfig MTK_MTD_NAND
	tristate "MediaTek Nand Support"
	depends on MTD_NAND
	help
	  NAND flash memory, a type of non-volatile storage device,
	  introduced by Toshiba in 1989. With formal commands,
	  controller can access data via devices.
	  This configuration enable Mediatek NAND controller to perform operations
	  on NAND devices of verious vendors.
	  For products choosing raw NAND as booting device,this configuration must say y.
	  Since kernel using MTD as storage device common driver,
	  this configuration depends on MTD_NAND config.
	  Please visit JEDEC sites for more information.

config MTK_MTD_NAND_INTERRUPT_SCHEME
	bool "Nand Read/Write with interrupt scheme"
	depends on MTK_MTD_NAND
	help
	  While performing page read/write to NAND device, controller use
	  DMA to send/receive data to/from device. There are two schemes to
	  wait until DMA finish its' job, polling and interrupt.
	  Using polling may quicker, but CPU resource won't be released.
	  Interrupt may suffer some software overhead, but CPU can be released.
	  This configuration is for user to chose from these two scheme.
	  Default using polling mode since DMA may not take too long.

config MTK_SLC_NAND_SUPPORT
	tristate "Mediatek SLC NAND Support"
	depends on MTK_MTD_NAND
	help
	  In electronics, a single-level cell (SLC) is a memory element capable of
	  storing a single bit of information.
	  SLC NAND flash is a flash memory technology using single levels per cell.
	  While using SLC devices as booting device, please set this configuration as
	  y to enable SLC features.

config MTK_SLC_NAND_BURNER_SUPPORT
	tristate "Mediatek SLC NAND Support Burner"
	depends on MTK_SLC_NAND_SUPPORT
	help
	  The burner using 'jump over bad block' mechanism to handle bad blocks,
	  For products choosing Burner as the device burning images to Nand Flash,
	  please set this configuration as 'y'.

config MTK_COMBO_NAND_SUPPORT
	tristate "Mediatek COMBO NAND Support"
	depends on MTK_MTD_NAND
	help
	  NAND memories are accessed much like block devices.
	  Each block consists of a number of pages.
	  Knowned that reading and programming is performed on a page basis,
	  and erasure can only be performed on a block basis.
	  Different devices have different block size and page size.
	  This configuration enables the multi devices in one load feature.

config MTK_FAT_ON_NAND
	tristate "Mediatek FAT on NAND Support"
	depends on MTK_MTD_NAND
	help
	  Enable FAT on nand feature of Mediatek NAND driver.
	  This will create a FAT partition on NAND device.
	  With this configuration turns on, user can use UMS to access native storage.
	  Without this configuration, users only use MTP to acces native storage.
	  Please see Project config for more information of this configuration.

config MTK_FACTORY_RESET_PROTECTION_SUPPORT
	bool "Mediatek FRP Support"
	depends on MTK_MTD_NAND
	help
	  FRP stands for factory reset protect.
	  This feature backup customer data after factory reset.
	  Turn on this configuration to enable data save after factory reset.
	  Enable this feature if want to open FRP.

config MTK_NAND_V2
	bool "Mediatek NAND Driver Version 2 Support"
	depends on MTK_MTD_NAND && !MTK_SLC_NAND_SUPPORT
	help
	  Enable mtk nand driver version 2.

config MTK_NAND_V3
	bool "Mediatek NAND Driver Version 3 Support"
	depends on MTK_MTD_NAND && MTK_SLC_NAND_SUPPORT
	help
	  Enable mtk nand driver version 3 which is for SLC solution.
```

## drivers/misc/mediatek/usb20/Kconfig
```kconfig
config USB_MTK_HDRC
	tristate "MediaTek MUSB support"
	select USB_GADGET_SELECTED
	select USB_GADGET_DUALSPEED
	help
		Say Y here if your system has a high speed USB
		controller based on the MTK MUSB IP.  Then
		configure options to match your silicon and the board
		it's being used with, including the USB peripheral role,
		or the USB host role, or both.

config MTK_MUSB_QMU_SUPPORT
	bool "QMU Transfer mode of MediaTek MUSB"
	depends on USB_MTK_HDRC
	help
		Say Y here if your system has a QMU capability for USB
		controller based on the MTK MUSB IP.
		QMU is some kind of enhanced DMA mode by HW queeu rather
		than SW queue to reduce SW effort.

config USB_MTK_OTG
	bool "MediaTek MUSB OTG support"
	help
		Enable Mediatek USB Host OTG detection mechanism
		and USB-IF Compliance Test Program.
		1. IDDIG - OTG cable attachment detection.
		2. DRVVBUS - provides the VBUS for the attached devices

config USB_MTK_CHARGER_DETECT
	bool "MediaTek MUSB charger detect"
	depends on MTK_USBFSH
	help
		If make port1 enable in mt8163, please open the config.
		When port0 is using, plug in device to port1,
		port0 will get the disconnect. fix the issue, need open
		the config.

config MTK_UART_USB_SWITCH
	bool "MediaTek UART could use USB DATA pins"
	help
		This is a feature for debugging purpose.
		It uses the USB TX/RX as UART TX/RX.
		A USB to UART cable is needed to use this feature.
		Using the UI in the EngineerMode to switch between USB and UART mode.
		After switching to UART mode and connect to the PC with a USB to UART cable,
		you can connect to a Virtual COM port on the PC and get the log output to the UART console.

config MTK_MUSB_CARPLAY_SUPPORT
	bool "MediaTek MUSB Carplay support"
	help
		Say Y here if your want to use carplay.

config MTK_MUSB_SW_WITCH_MODE
	bool "MediaTek MUSB provide user space interface to switch usb role without id pin"
	help
		Usb host/device/idle mode switch through command, not only depend on ID pin.
		Say Y here if your want to use software to switch usb mode.

config MTK_MUSB_PORT0_LOWPOWER_MODE
	bool "MediaTek MUSB PORT0 low power mode support"
	help
		Dynamic control the usb port0 clock when PORT1 not exist.
		Say Y here if your want to enable port0 low power mode for saving power.

config USB_VBUSDET_IN_GPIO
	bool "MediaTek MUSB is used to detect vBus event via GPIO"
	help
		Some application have no PMIC design or vBus is not connected with VCDT in PMIC,
		therefore. MTK MUSB is used to use one GPIO input to detect vBus event.
		Actually, we need other GPIO pin to manipulate vBus power supply for Host role,
		and the GPIO will make vBus power off when device role.
		If unsure, say N.

config USB_PHYCHK_EXTCONN
	bool "MediaTek MUSB to detect USB external connector with phy test mode"
	help
		To detect USB simple external connector with MTK phy test mode.
		invoke mt_usb_phychk_extconn to get usb external connector
		on the beginning of vBus detected. It will switch to phy test mode
		to check simple external connector, then switch back usb phy normal mode
		for usb device role connect.
		If unsure, say N.

config MTK_MUSB_PORT0_WAKELOCK_FORCE_SUSPEND
	bool "MediaTek MUSB PORT0 force suspend support while hold wakelock"
	help
		Whether USB PORT0 supports force suspend or not while hoding wakelock.
		Generally, when usb is connected as adb mode, usb will hode wakelock
		for avoiding disconnect while user is working with adb shell. Now, 
		force suspend can be set to let usb driver to be forced to suspend 
		state. It will cause usb to be abnormal.		
		Note:Note:Note: never enable the config when you don't understand it!!!

config MTK_MUSB_PORT0_RESUME_CONNECT_USB
	bool "MediaTek MUSB PORT0 force connect usb function after system resume"
	depends on MTK_MUSB_PORT0_WAKELOCK_FORCE_SUSPEND
	help
		After system resume, maybe you need to resume connect to the usb
		function, eg: adb. If not, some platform can be hard to debug.
		Note:Note:Note: never enable the config when you don't understand it!!!

config MTK_USB_DISABLE_SDP
	bool "Mediatek MUSB Disable SDP or not"
	help
		If MUSB detects the connecting USB Port is SDP, it will reset the platform.
		The feature is from: some platform can consume more than 500ma current, 
		so, if connect to SDP, then will not bootup.
		If you do not understand the feature, never use it.
```
